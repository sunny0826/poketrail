UI_MESSAGE(TargetOwned, "已拥有此形态", "You already own this form")
UI_MESSAGE(InsufficientProgress, "培养步数还不够", "Not enough training steps")
UI_MESSAGE(PartnerChanged, "伙伴已变化，请重新选择", "Partner changed; select again")
UI_MESSAGE(FinishAndCarry, "先携带它并完成当前流程", "Carry it and finish this encounter")
UI_MESSAGE(LegacyBalls, "升级前的遭遇仍按旧规则用球", "Old encounters use stored balls")
UI_MESSAGE(WaitForSave, "等待保存成功", "Waiting for save")
UI_MESSAGE(CannotAct, "当前无法执行", "Cannot do this now")
UI_MESSAGE(TryLater, "稍后再试", "Try again later")
UI_MESSAGE(ConfirmEvolution, "确认进化", "Confirm evolution")
UI_MESSAGE(EvolutionCost, "使用 %lu 培养步", "Use %lu training steps")
UI_MESSAGE(OriginalUnavailable, "原形态不再可携带", "Original form cannot be carried")
UI_MESSAGE(Later, "稍后", "Later")
UI_MESSAGE(RemainderStays, "余下培养步留在原形态", "Unused steps stay with old form")
UI_MESSAGE(CapturedNeverReturns, "已捕获的原形态不会再遇到", "Caught forms will not reappear")
UI_MESSAGE(WalkedAvailable, "陪伴 %llu · 可用 %llu 步", "Walked %llu · Available %llu steps")
UI_MESSAGE(WalkedSteps, "陪伴 %llu 步", "Walked %llu steps")
UI_MESSAGE(AvailableSteps, "可用 %llu 步", "Available %llu steps")
UI_MESSAGE(EvolutionSaved, "进化已保存", "Evolution saved")
UI_MESSAGE(CarryFirst, "先携带这位伙伴", "Carry this partner first")
UI_MESSAGE(FinalFormReady, "已是最终形态", "Already in final form")
UI_MESSAGE(EvolutionNeeds, "%s需 %lu 步", "%s needs %lu steps")
UI_MESSAGE(Carried, "已携带", "Carried")
UI_MESSAGE(SelectPartner, "选择携带", "Carry this partner")
UI_MESSAGE(OwnedNote, "已拥有", "Owned")
UI_MESSAGE(NotReady, "未达标", "Not ready")
UI_MESSAGE(BackToPartners, "返回伙伴列表", "Back to partners")
UI_MESSAGE(EditDateTime, "编辑日期与时间", "Edit date and time")
UI_MESSAGE(ClockError, "日期无效或校时失败，请重新确认", "Invalid time or sync failed; retry")
UI_MESSAGE(ClockKeys, "左减 · 右加 · 双键完成", "Left - · Right + · Both: done")
UI_MESSAGE(EnterCurrentTime, "手动输入当前时间", "Enter the current time")
UI_MESSAGE(Year, "年", "Year")
UI_MESSAGE(Month, "月", "Month")
UI_MESSAGE(Day, "日", "Day")
UI_MESSAGE(Hour, "时", "Hour")
UI_MESSAGE(Minute, "分", "Minute")
UI_MESSAGE(TimezoneMinutes, "时区分钟", "UTC offset (min)")
UI_MESSAGE(ClockNormal, "普通校时", "Set time")
UI_MESSAGE(ClockTimezone, "时区变更", "Time zone")
UI_MESSAGE(ClockCorrect, "修正错误日期", "Fix date")
UI_MESSAGE(ClockMode, "校时模式", "Mode")
UI_MESSAGE(SaveClock, "保存并校时", "Save and sync")
UI_MESSAGE(BottomBack, "轻触下方返回", "Tap below to go back")
UI_MESSAGE(FullDay, "完整日", "Full day")
UI_MESSAGE(PartialDay, "部分日", "Partial day")
UI_MESSAGE(TimeNotSet, "时间未知 · 尚未校准", "Time unknown · Clock not set")
UI_MESSAGE(DailyStepsUnknown, "当日步数未知", "Daily steps unknown")
UI_MESSAGE(TodaySteps, "今日 %llu 步", "Today: %llu steps")
UI_MESSAGE(TotalSteps, "累计 %llu 步", "Total: %llu steps")
UI_MESSAGE(DailyBadges, "每日：%s%s%s%s", "Daily: %s%s%s%s")
UI_MESSAGE(OneThousand, "1千 ", "1k ")
UI_MESSAGE(ThreeThousand, "3千 ", "3k ")
UI_MESSAGE(FiveThousand, "5千步", "5k steps")
UI_MESSAGE(NoMilestones, "尚无里程碑", "No milestones")
UI_MESSAGE(TotalBadges, "累计：%s%s%s%s", "Total: %s%s%s%s")
UI_MESSAGE(TenThousand, "1万 ", "10k ")
UI_MESSAGE(FiftyThousand, "5万 ", "50k ")
UI_MESSAGE(HundredThousand, "10万步", "100k steps")
UI_MESSAGE(FirstCaptureCards, "永久首捕卡", "First captures")
UI_MESSAGE(RecentCaptures, "最近捕捉", "Recent catches")
UI_MESSAGE(DailySteps, "每日步数", "Daily steps")
UI_MESSAGE(Milestones, "里程碑", "Milestones")
UI_MESSAGE(BackToRecords, "返回记录目录", "Back to records")
UI_MESSAGE(DayEpoch, "%u · 计时段 %u", "%u · Period %u")
UI_MESSAGE(DateUnknown, "日期未知", "Date unknown")
UI_MESSAGE(MilestoneSteps, "%s %u 步", "%s %u steps")
UI_MESSAGE(Daily, "每日", "Daily")
UI_MESSAGE(Total, "累计", "Total")
UI_MESSAGE(GiftNotCaught, "初始赠送 · 尚无实际首捕", "Starter gift · Not caught yet")
UI_MESSAGE(NoCaptureRecord, "还没有捕获记录", "No catches yet")
UI_MESSAGE(BrowsingNoCapture, "自由浏览不会产生首捕卡", "Browsing does not count as a catch")
UI_MESSAGE(RouteCaptureCount, "%s · 累计捕捉 %u 次", "%s · Caught %u times")
UI_MESSAGE(FullDaySteps, "步 · 完整日", "Steps · Full day")
UI_MESSAGE(PartialDaySteps, "步 · 部分记录", "Steps · Partial day")
UI_MESSAGE(Reached, "已达成", "Reached")
UI_MESSAGE(NotReached, "未达成", "Not reached")
UI_MESSAGE(NotReachedYet, "尚未达成", "Not reached yet")
UI_MESSAGE(StepRatio, "%llu / %u 步", "%llu / %u steps")
UI_MESSAGE(TodayPartialSteps, "今日已记录 · 步", "Today (partial) · Steps")
UI_MESSAGE(TodayStepLabel, "今日 · 步", "Today · Steps")
UI_MESSAGE(TodayPartial, "今日已记录", "Today (partial)")
UI_MESSAGE(Today, "今日", "Today")
UI_MESSAGE(Steps, "步", "steps")
UI_MESSAGE(PartnerImageFailed, "伙伴画面不可用", "Partner image unavailable")
UI_MESSAGE(Carrying, "携带中", "Carried")
UI_MESSAGE(Evolve, "进化", "Evolve")
UI_MESSAGE(TodayUnknown, "今日 --", "Today --")
UI_MESSAGE(StepsIncomplete, "部分步数缺失", "Some steps are missing")
UI_MESSAGE(BackupRestored, "已从备用存档恢复", "Backup restored")
UI_MESSAGE(EncounterMenuHint, "发现宝可梦 · 侧键打开菜单", "Found one · L / R: menu")
UI_MESSAGE(CaptureMenuHint, "待捕捉 · 侧键打开菜单", "Catch ready · L / R: menu")
UI_MESSAGE(SideKeysMenu, "左 / 右键打开菜单", "Left / Right: open menu")
UI_MESSAGE(ReleaseThrowCost, "松手投球 · 未投出也计一次", "Release to throw · Timeout = 1 try")
UI_MESSAGE(PracticeNoCollection, "成功不会收入图鉴", "Practice catch not kept")
UI_MESSAGE(HoldThrow, "按住右键蓄力 · 松手投球", "Hold right: charge · Release: throw")
UI_MESSAGE(EndPracticeTop, "轻触顶部结束练习", "Top: end practice")
UI_MESSAGE(PracticeSuccess, "练习成功", "Practice successful")
UI_MESSAGE(BattleLost, "对战失败", "Battle lost")
UI_MESSAGE(PracticeEnded, "练习结束", "Practice ended")
UI_MESSAGE(NotCollected, "未收入图鉴", "Not added to collection")
UI_MESSAGE(BattleTryAgain, "对战失败 · 下次再试", "Battle lost · Try again")
UI_MESSAGE(PokemonFled, "宝可梦逃走了", "The Pokémon fled")
UI_MESSAGE(PracticeAgain, "再练一只", "Practice again")
UI_MESSAGE(ReturnExploration, "返回探索", "Back to exploring")
UI_MESSAGE(CatchSuccess, "捕获成功", "Caught!")
UI_MESSAGE(BrokeFree, "挣脱了", "Broke free")
UI_MESSAGE(EvolutionPreview, "进化预览", "Evolution preview")
UI_MESSAGE(EvolutionComplete, "进化完成", "Evolution complete")
UI_MESSAGE(Evolving, "正在进化", "Evolving")
UI_MESSAGE(PressContinue, "按键 / 轻触继续", "Press / tap to continue")
UI_MESSAGE(PressSkip, "按键 / 轻触跳过", "Press / tap to skip")
UI_MESSAGE(RouteForest, "森林", "Forest")
UI_MESSAGE(RouteSea, "海边", "Seaside")
UI_MESSAGE(RouteCave, "洞窟", "Cave")
UI_MESSAGE(RouteKanto, "关都", "Kanto")
UI_MESSAGE(RouteJohto, "城都", "Johto")
UI_MESSAGE(RouteHoenn, "丰缘", "Hoenn")
UI_MESSAGE(RouteSinnoh, "神奥", "Sinnoh")
UI_MESSAGE(RouteUnova, "合众", "Unova")
UI_MESSAGE(Unknown, "未知", "Unknown")
UI_MESSAGE(NoSelection, "未选择", "Not selected")
UI_MESSAGE(GraphicsError, "画面不可用，请重启", "Display unavailable; restart")
UI_MESSAGE(CarryNote, "携带", "Carried")
UI_MESSAGE(Home, "首页", "Home")
UI_MESSAGE(TestBadge, "测试", "Test")
UI_MESSAGE(NoBalls, "本场没有可用精灵球", "No balls for this encounter")
UI_MESSAGE(EndEncounter, "结束本场 · 返回探索", "End encounter · Explore")
UI_MESSAGE(CapturePractice, "捕获练习", "Catch practice")
UI_MESSAGE(RhythmBattle, "节奏对战", "Rhythm battle")
UI_MESSAGE(Hit, "命中", "Hit")
UI_MESSAGE(Miss, "未命中", "Miss")
UI_MESSAGE(Dodged, "躲开了", "Dodged")
UI_MESSAGE(Hurt, "受伤了", "Hurt")
UI_MESSAGE(Frenzy, "狂暴", "Frenzy")
UI_MESSAGE(AttackSpecial, "右键攻击 · 双键必杀", "Right: attack · Both: special")
UI_MESSAGE(Attack, "右键 · 攻击", "Right · Attack")
UI_MESSAGE(Dodge, "左键 · 躲避", "Left · Dodge")
UI_MESSAGE(PauseAfterBeat, "本拍结束后暂停", "Pause after this beat")
UI_MESSAGE(SpecialHit, "必杀命中", "Special hit")
UI_MESSAGE(PokedexCount, "%u 图鉴", "Pokédex · %u")
UI_MESSAGE(FirstCapturesCount, "永久首捕 · %u种", "First captures · %u")
UI_MESSAGE(NoEncounter, "暂无遭遇", "No encounter yet")
UI_MESSAGE(ResumeCatch, "继续捕捉", "Resume catch")
UI_MESSAGE(ResumeEncounter, "继续遭遇", "Resume encounter")
UI_MESSAGE(ChooseRegion, "选择地区", "Choose region")
UI_MESSAGE(MyPartners, "我的伙伴", "My partners")
UI_MESSAGE(Resources, "资源与数据", "Stats and records")
UI_MESSAGE(SleepNow, "立即省电", "Sleep now")
UI_MESSAGE(CaptureWalkRecords, "捕捉与步行记录", "Catch and step records")
UI_MESSAGE(SetDateTime, "设置日期时间", "Set date and time")
UI_MESSAGE(SkipDateTime, "暂不设置", "Set later")
UI_MESSAGE(BrowsePokedex, "浏览图鉴", "Browse Pokédex")
UI_MESSAGE(StartBattle, "开始对战", "Start battle")
UI_MESSAGE(ChoosePartner, "选择伙伴", "Choose partner")
UI_MESSAGE(BattleLater, "稍后再战", "Battle later")
UI_MESSAGE(Continue, "继续", "Continue")
UI_MESSAGE(ConfirmRetreat, "确认撤退", "Confirm retreat")
UI_MESSAGE(RecentThirtyTwo, "最近32次捕捉", "Last 32 catches")
UI_MESSAGE(TodayAndHistory, "今日与14日日汇总", "Today and past 14 days")
UI_MESSAGE(DailyLifetime, "每日与长期里程碑", "Daily and total milestones")
UI_MESSAGE(RetrySaveLoad, "重试保存 / 读取", "Retry save / load")
UI_MESSAGE(AcceptResult, "确认结果 · 继续探索", "Confirm · Keep exploring")
UI_MESSAGE(WalkingAdventure, "步行探险", "Explore")
UI_MESSAGE(StepsRoute, "%s %llu 步 · %s", "%s %llu steps · %s")
UI_MESSAGE(LastRecord, "上次记录", "Last record")
UI_MESSAGE(Training, "培养", "Training")
UI_MESSAGE(FinalForm, "最终形态", "Final form")
UI_MESSAGE(TrainingRatio, "%llu / %lu 步", "%llu / %lu steps")
UI_MESSAGE(AllCaught, "普通宝可梦已全部捕获", "All regular Pokémon caught")
UI_MESSAGE(RegionCaught, "本地区已捕获完 · 可换地区", "Region complete · Try another")
UI_MESSAGE(NextEncounterSteps, "下次遭遇还差 %llu 步", "Next encounter in %llu steps")
UI_MESSAGE(EncounterWaiting, "已有遭遇 · 随时继续", "Encounter ready · Resume anytime")
UI_MESSAGE(ConfirmDate, "先确认日期", "Check the date")
UI_MESSAGE(ClockPending, "上次校时未完成，请重新确认", "Last time sync incomplete; retry")
UI_MESSAGE(OfflineClock, "设备离线计时，无需手机", "Offline clock · No phone needed")
UI_MESSAGE(SkipKeepsSteps, "暂不设置仍可累计步数", "Steps count even without a date")
UI_MESSAGE(CaptureTimeUnknown, "捕捉时间会记为未知", "Catch times will be unknown")
UI_MESSAGE(ChooseStarter, "选择最初的伙伴", "Choose your starter")
UI_MESSAGE(StarterOnce, "只能领取一次", "Choose only once")
UI_MESSAGE(NextEncounterOnly, "只影响下一场遭遇", "Affects the next encounter only")
UI_MESSAGE(OwnedCount, "%u 位已拥有", "%u owned")
UI_MESSAGE(PokemonFound, "发现宝可梦", "Pokémon found")
UI_MESSAGE(Paused, "已暂停", "Paused")
UI_MESSAGE(PracticeFree, "练习不消耗机会", "Practice uses no attempts")
UI_MESSAGE(ResumeNextBeat, "继续后进入下一拍", "Resume at the next beat")
UI_MESSAGE(CaptureSuccess, "捕捉成功", "Caught!")
UI_MESSAGE(BattleOver, "对战结束", "Battle over")
UI_MESSAGE(Retreated, "已经撤退", "Retreated")
UI_MESSAGE(AlreadyCaughtEnd, "已捕获 · 遭遇结束", "Already caught · Encounter ended")
UI_MESSAGE(CaptureAbandoned, "已放弃捕捉", "Catch abandoned")
UI_MESSAGE(LegacySettled, "旧遭遇已结清", "Old encounter settled")
UI_MESSAGE(PokemonLeft, "宝可梦离开了", "The Pokémon left")
UI_MESSAGE(FirstCapture, "首次捕获", "First catch")
UI_MESSAGE(RouteTimeUnknown, "%s · 时间未知", "%s · Time unknown")
UI_MESSAGE(MigrationRefund, "升级已退回 500 探索步", "Update refunded 500 explore steps")
UI_MESSAGE(UnlimitedBalls, "精灵球不限量", "Unlimited Poké Balls")
UI_MESSAGE(EncounterEnded, "已结束本场", "Encounter ended")
UI_MESSAGE(NoRefund, "不退探索步数或已用精灵球", "Spent steps and balls not refunded")
UI_MESSAGE(KeepExploring, "伙伴仍在，继续步行探索", "Partner stays · Keep exploring")
UI_MESSAGE(BestDaySteps, "每日最高 %llu 步", "Best day: %llu steps")
UI_MESSAGE(SaveUnavailable, "暂时无法保存", "Cannot save yet")
UI_MESSAGE(StorageUnavailable, "存储不可用", "Storage unavailable")
UI_MESSAGE(ResultUnconfirmed, "结果尚未确认", "Result not confirmed yet")
UI_MESSAGE(GameplayPaused, "玩法已暂停", "Adventure paused")
UI_MESSAGE(RetrySameResult, "保存失败 · 重试将保留同一次结果", "Save failed · Retry the same result")
UI_MESSAGE(StorageIoFailed, "存储读写失败", "Storage read / write failed")
UI_MESSAGE(StorageUninitialized, "存储未初始化", "Storage not initialized")
UI_MESSAGE(CorruptPreserved, "存档损坏 · 保留原文件", "Damaged save · Files kept")
UI_MESSAGE(NewerSave, "存档版本较新 · 请升级", "Newer save · Update firmware")
UI_MESSAGE(PreviewEvolution, "预览进化", "Preview evolution")
UI_MESSAGE(ViewerControls, "互动 · 按键切换 · 顶部返回", "Tap: play · Keys: browse")
